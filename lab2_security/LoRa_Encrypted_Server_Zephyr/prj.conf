## CMakeLists.txt
```
# SPDX-License-Identifier: Apache-2.0

cmake_minimum_required(VERSION 3.20.0)

find_package(Zephyr REQUIRED HINTS $ENV{ZEPHYR_BASE})
project(lora_encrypted_server)

# Arduino Crypto library (sources included in ../Crypto)
set(CRYPTO_DIR "${CMAKE_CURRENT_SOURCE_DIR}/../Crypto/src" CACHE PATH "Arduino Crypto library sources")

set(crypto_sources
  ${CRYPTO_DIR}/AES128.cpp
  ${CRYPTO_DIR}/AESCommon.cpp
  ${CRYPTO_DIR}/BigNumberUtil.cpp
  ${CRYPTO_DIR}/BlockCipher.cpp
  ${CRYPTO_DIR}/Crypto.cpp
  ${CRYPTO_DIR}/Curve25519.cpp
  ${CRYPTO_DIR}/Ed25519.cpp
  ${CRYPTO_DIR}/Hash.cpp
  ${CRYPTO_DIR}/SHA256.cpp
  ${CRYPTO_DIR}/SHA512.cpp)

# The library's own RNG.h needs Arduino; shim/RNG.h replaces it (included first)
set_source_files_properties(${crypto_sources} PROPERTIES
  COMPILE_OPTIONS "-include;${CMAKE_CURRENT_SOURCE_DIR}/shim/RNG.h")

FILE(GLOB app_sources src/*.c src/*.cpp)
target_sources(app PRIVATE ${app_sources} ${crypto_sources})
target_include_directories(app PRIVATE shim ${CRYPTO_DIR})

# Shared, host-testable protocol and Zephyr radio adapter.
set(SECURITY_COMMON "${CMAKE_CURRENT_SOURCE_DIR}/../LoRa_Security_Common")
if(NOT EXISTS "${CMAKE_CURRENT_SOURCE_DIR}/src/identity.h")
  message(FATAL_ERROR "Run python3 ../tools/provision.py before building both boards")
endif()
target_sources(app PRIVATE ${SECURITY_COMMON}/security_protocol.c ${SECURITY_COMMON}/lora_app.c)
target_include_directories(app PRIVATE src ${SECURITY_COMMON})
```

## prj.conf
```kconfig
CONFIG_LOG=y
CONFIG_LORA=y
CONFIG_PRINTK=y
CONFIG_CPP=y
CONFIG_STD_CPP17=y
CONFIG_ENTROPY_GENERATOR=y
CONFIG_CSPRNG_NEEDED=y
CONFIG_MAIN_STACK_SIZE=8192
CONFIG_HW_STACK_PROTECTION=y
```

## src/main.c
```c
/* SPDX-License-Identifier: Apache-2.0 */
#include "lora_app.h"
#include "identity.h" /* Generated locally by tools/provision.py. */

int main(void)
{
    return secure_lora_main(PROTO_SERVER, &board_identity);
}
```

## src/sec_crypto.cpp
```c
#include "sec_crypto.h"

#include "RNG.h" /* shim: backs the library's RNG with Zephyr's CSPRNG */
#include "Curve25519.h"
#include "Ed25519.h"
#include "SHA256.h"
#include "AES.h"
#include "Crypto.h"
#include <string.h>

RNGClass RNG;

extern "C" {

void sec_random(uint8_t *buf, size_t len)
{
	RNG.rand(buf, len);
}

void sec_sign_keygen(uint8_t pub[SEC_PUBKEY_LEN], uint8_t priv[SEC_PRIVKEY_LEN])
{
	Ed25519::generatePrivateKey(priv);
	Ed25519::derivePublicKey(pub, priv);
}

void sec_sign(uint8_t sig[SEC_SIG_LEN], const uint8_t priv[SEC_PRIVKEY_LEN],
	      const uint8_t pub[SEC_PUBKEY_LEN], const uint8_t *msg, size_t len)
{
	Ed25519::sign(sig, priv, pub, msg, len);
}

bool sec_verify(const uint8_t sig[SEC_SIG_LEN], const uint8_t pub[SEC_PUBKEY_LEN],
		const uint8_t *msg, size_t len)
{
	return Ed25519::verify(sig, pub, msg, len);
}

void sec_dh_keygen(uint8_t pub[SEC_PUBKEY_LEN], uint8_t priv[SEC_PRIVKEY_LEN])
{
	/* dh1 generates and clamps a random private key f and outputs k = f * base */
	Curve25519::dh1(pub, priv);
}

bool sec_dh_shared(uint8_t secret[32], const uint8_t their_pub[SEC_PUBKEY_LEN],
		   uint8_t priv[SEC_PRIVKEY_LEN])
{
	for (int i = 0; i < 32; i++) {
		secret[i] = their_pub[i];
	}
	/* dh2 turns k (their public key) into the shared secret and wipes f */
	return Curve25519::dh2(secret, priv);
}

void sec_sha256(uint8_t out[SEC_HASH_LEN], const uint8_t *data, size_t len)
{
	SHA256 sha;

	sha.reset();
	sha.update(data, len);
	sha.finalize(out, SEC_HASH_LEN);
}

void sec_hkdf_aes128(uint8_t out[16], const uint8_t secret[32], const uint8_t salt[32])
{
    /* RFC 5869 extract, then one expand block; retain its first 16 bytes. */
    static const uint8_t info[] = "ESE5180 LoRa AES128 v1";
    uint8_t prk[32], output[32];
    const uint8_t counter = 1;
    SHA256 sha;
    sha.resetHMAC(salt, 32);
    sha.update(secret, 32);
    sha.finalizeHMAC(salt, 32, prk, 32);
    sha.resetHMAC(prk, 32);
    sha.update(info, sizeof(info) - 1);
    sha.update(&counter, 1);
    sha.finalizeHMAC(prk, 32, output, 32);
    memcpy(out, output, 16);
    clean(prk);
    clean(output);
}

void sec_aes128_encrypt(uint8_t *out, const uint8_t key[SEC_AES_KEY_LEN],
			const uint8_t *in, size_t len)
{
	AES128 aes;

	aes.setKey(key, SEC_AES_KEY_LEN);
	for (size_t i = 0; i + SEC_AES_BLOCK <= len; i += SEC_AES_BLOCK) {
		aes.encryptBlock(out + i, in + i);
	}
}

void sec_aes128_decrypt(uint8_t *out, const uint8_t key[SEC_AES_KEY_LEN],
			const uint8_t *in, size_t len)
{
	AES128 aes;

	aes.setKey(key, SEC_AES_KEY_LEN);
	for (size_t i = 0; i + SEC_AES_BLOCK <= len; i += SEC_AES_BLOCK) {
		aes.decryptBlock(out + i, in + i);
	}
}

} /* extern "C" */
```
