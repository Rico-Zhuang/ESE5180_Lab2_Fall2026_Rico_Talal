## prj.conf
```kconfig
# Settings shared by every variant.
# The AES implementation itself is chosen by ONE overlay file:
#   sw_ram.conf, sw_rom.conf, sw_rom_fewer.conf or hw.conf

CONFIG_PRINTK=y
# Cycle-accurate timer (Cortex-M4 DWT counter).
CONFIG_TIMING_FUNCTIONS=y
# STM32 hardware RNG.
CONFIG_ENTROPY_GENERATOR=y
CONFIG_MAIN_STACK_SIZE=4096
```

## src/main.c
```c
/*
 * Lab 2, Part 2: Encryption speed and memory tradeoffs (NUCLEO-WL55JC)
 *
 * Measures one AES-128 variant per build:
 *   - correctness against the FIPS-197 test vector
 *   - key setup time (first call "cold", then averaged "warm")
 *   - encrypt / decrypt time for one full LoRa payload, and per byte
 *
 * The variant is picked by the overlay passed with -DEXTRA_CONF_FILE=...
 */
#include <string.h>
#include <zephyr/kernel.h>
#include <zephyr/sys/printk.h>
#include <zephyr/timing/timing.h>

#include "aes_backend.h"

#if defined(CONFIG_CRYPTO_STM32)
static const struct aes_backend *const aes = &aes_hw_stm32;
#elif defined(CONFIG_PSA_CRYPTO)
static const struct aes_backend *const aes = &aes_sw_psa;
#else
#error "No AES variant selected: build with -DEXTRA_CONF_FILE=sw_ram.conf (or sw_rom, sw_rom_fewer, hw)"
#endif

/* Largest encrypted payload in one LoRa packet:
 * 255 B max packet - 64 B Ed25519 signature = 191 B, rounded down to 16 B blocks */
#define MSG_LEN    176
#define ITERATIONS 200

/* FIPS-197 Appendix C.1 (AES-128) known-answer test */
static const uint8_t kat_key[16] = {
	0x00, 0x01, 0x02, 0x03, 0x04, 0x05, 0x06, 0x07,
	0x08, 0x09, 0x0a, 0x0b, 0x0c, 0x0d, 0x0e, 0x0f};
static const uint8_t kat_pt[16] = {
	0x00, 0x11, 0x22, 0x33, 0x44, 0x55, 0x66, 0x77,
	0x88, 0x99, 0xaa, 0xbb, 0xcc, 0xdd, 0xee, 0xff};
static const uint8_t kat_ct[16] = {
	0x69, 0xc4, 0xe0, 0xd8, 0x6a, 0x7b, 0x04, 0x30,
	0xd8, 0xcd, 0xb7, 0x80, 0x70, 0xb4, 0xc5, 0x5a};

static uint8_t msg[MSG_LEN], pt[MSG_LEN], ct[MSG_LEN];

static inline uint64_t cycles_between(timing_t *a, timing_t *b)
{
	return timing_cycles_get(a, b);
}

/* Print a cycle count as "<cycles> cyc  <ns>.<2 digits> ns" divided by div */
static void print_time(const char *label, uint64_t cycles, uint32_t div)
{
	uint64_t ns_x100 = timing_cycles_to_ns(cycles * 100U) / div;

	printk("  %-28s %8llu cyc  %8llu.%02llu ns\n", label, cycles / div,
	       ns_x100 / 100U, ns_x100 % 100U);
}

static int known_answer_test(void)
{
	uint8_t out[16];

	if (aes->enc_setup(kat_key) || aes->encrypt(out, kat_pt, 16)) {
		return -1;
	}
	aes->enc_teardown();
	if (memcmp(out, kat_ct, 16) != 0) {
		return -2;
	}

	if (aes->dec_setup(kat_key) || aes->decrypt(out, kat_ct, 16)) {
		return -3;
	}
	aes->dec_teardown();
	return memcmp(out, kat_pt, 16) ? -4 : 0;
}

int main(void)
{
	timing_t t0, t1;
	uint64_t cold_setup, setup_sum = 0, enc_sum = 0, dec_sum = 0;
	uint8_t key[16];
	int ret;

	for (int i = 0; i < MSG_LEN; i++) {
		msg[i] = (uint8_t)(i * 7 + 3);
	}
	memcpy(key, kat_key, sizeof(key));

	timing_init();
	timing_start();

	printk("\n=== AES-128 benchmark: %s ===\n", aes->name);
	printk("CPU timer: %u MHz, message: %d B, iterations: %d\n",
	       timing_freq_get_mhz(), MSG_LEN, ITERATIONS);

	if (aes->init()) {
		printk("init FAILED\n");
		timing_stop();
		return 0;
	}

	/* 1. Cold key setup: the very first call (may build tables, wake HW, ...) */
	t0 = timing_counter_get();
	ret = aes->enc_setup(key);
	t1 = timing_counter_get();
	if (ret) {
		goto failed;
	}
	aes->enc_teardown();
	cold_setup = cycles_between(&t0, &t1);

	/* 2. Correctness */
	int kat = known_answer_test();

	printk("FIPS-197 known-answer test: %s\n", kat ? "FAIL" : "PASS");
	if (kat) {
		printk("  (error %d), not timing a broken implementation\n", kat);
		timing_stop();
		return 0;
	}

	/* Time only each AES call. Teardown, checks, and accumulation stay
	 * outside its measurement window. */
	for (int i = 0; i < ITERATIONS; i++) {
		t0 = timing_counter_get();
		ret = aes->enc_setup(key);
		t1 = timing_counter_get();
		if (ret) {
			goto failed;
		}
		aes->enc_teardown();
		setup_sum += cycles_between(&t0, &t1);
	}

	/* Set up the key once, then encrypt a full message per iteration. */
	ret = aes->enc_setup(key);
	if (ret) {
		goto failed;
	}
	for (int i = 0; i < ITERATIONS; i++) {
		t0 = timing_counter_get();
		ret = aes->encrypt(ct, msg, MSG_LEN);
		t1 = timing_counter_get();
		if (ret) {
			aes->enc_teardown();
			goto failed;
		}
		enc_sum += cycles_between(&t0, &t1);
	}
	aes->enc_teardown();

	/* Decrypt the resulting ciphertext with setup outside the timer. */
	ret = aes->dec_setup(key);
	if (ret) {
		goto failed;
	}
	for (int i = 0; i < ITERATIONS; i++) {
		t0 = timing_counter_get();
		ret = aes->decrypt(pt, ct, MSG_LEN);
		t1 = timing_counter_get();
		if (ret) {
			aes->dec_teardown();
			goto failed;
		}
		dec_sum += cycles_between(&t0, &t1);
	}
	aes->dec_teardown();

	timing_stop();

	if (setup_sum == 0 || enc_sum == 0 || dec_sum == 0) {
		printk("Timing measurement FAILED: zero cycle count\n");
		return 0;
	}

	printk("Round trip of %d B payload: %s\n", MSG_LEN,
	       memcmp(pt, msg, MSG_LEN) ? "MISMATCH" : "OK");
	if (memcmp(pt, msg, MSG_LEN)) {
		return 0;
	}

	printk("Results (average per call):\n");
	print_time("key setup, first call", cold_setup, 1);
	print_time("key setup", setup_sum, ITERATIONS);
	print_time("encrypt 176 B payload", enc_sum, ITERATIONS);
	print_time("decrypt 176 B payload", dec_sum, ITERATIONS);
	print_time("encrypt per byte", enc_sum, ITERATIONS * MSG_LEN);
	print_time("decrypt per byte", dec_sum, ITERATIONS * MSG_LEN);

	/* One line to paste into a spreadsheet */
	uint64_t enc_ns = timing_cycles_to_ns(enc_sum) / ITERATIONS;

	printk("CSV,\"%s\",%llu,%llu,%llu,%llu,%llu.%03llu\n", aes->name, cold_setup,
	       setup_sum / ITERATIONS, enc_sum / (ITERATIONS * MSG_LEN),
	       dec_sum / (ITERATIONS * MSG_LEN), enc_ns / 1000U, enc_ns % 1000U);
	printk("    (variant, cold setup cyc, setup cyc, enc cyc/B, dec cyc/B, enc 176 B us)\n");

	return 0;

failed:
	timing_stop();
	printk("AES operation FAILED (%d); no timing results\n", ret);
	return 0;
}
```

## src/aes_hw_stm32.c
```c
/* AES-128 on the STM32WL55 hardware AES peripheral, through Zephyr's
 * crypto driver API (driver: crypto_stm32, devicetree node "aes"). */
#include <string.h>
#include <zephyr/kernel.h>

#if defined(CONFIG_CRYPTO_STM32)

#include <zephyr/device.h>
#include <zephyr/crypto/crypto.h>
#include "aes_backend.h"

static const struct device *const aes_dev = DEVICE_DT_GET(DT_NODELABEL(aes));
static struct cipher_ctx ctx;
static uint8_t key_copy[AES_KEY_LEN]; /* driver keeps a pointer, not a copy */

static int hw_init(void)
{
	return device_is_ready(aes_dev) ? 0 : -ENODEV;
}

/* "Key setup" here = open a driver session (configures the peripheral) */
static int hw_setup(const uint8_t key[AES_KEY_LEN], enum cipher_op dir)
{
	memcpy(key_copy, key, AES_KEY_LEN);
	ctx = (struct cipher_ctx){
		.keylen = AES_KEY_LEN,
		.key.bit_stream = key_copy,
		.flags = CAP_RAW_KEY | CAP_SEPARATE_IO_BUFS | CAP_SYNC_OPS,
	};
	return cipher_begin_session(aes_dev, &ctx, CRYPTO_CIPHER_ALGO_AES,
				    CRYPTO_CIPHER_MODE_ECB, dir);
}

static int hw_enc_setup(const uint8_t key[AES_KEY_LEN])
{
	return hw_setup(key, CRYPTO_CIPHER_OP_ENCRYPT);
}

static int hw_dec_setup(const uint8_t key[AES_KEY_LEN])
{
	return hw_setup(key, CRYPTO_CIPHER_OP_DECRYPT);
}

/* The driver only accepts ONE 16-byte block per ECB call, so loop */
static int hw_process(uint8_t *out, const uint8_t *in, size_t len)
{
	for (size_t i = 0; i < len; i += AES_BLOCK_LEN) {
		struct cipher_pkt pkt = {
			.in_buf = (uint8_t *)(in + i),
			.in_len = AES_BLOCK_LEN,
			.out_buf = out + i,
			.out_buf_max = AES_BLOCK_LEN,
		};
		int ret = cipher_block_op(&ctx, &pkt);

		if (ret) {
			return ret;
		}
	}
	return 0;
}

static void hw_teardown(void)
{
	cipher_free_session(aes_dev, &ctx);
}

const struct aes_backend aes_hw_stm32 = {
	.name = "HW (STM32 AES peripheral)",
	.init = hw_init,
	.enc_setup = hw_enc_setup,
	.encrypt = hw_process,
	.enc_teardown = hw_teardown,
	.dec_setup = hw_dec_setup,
	.decrypt = hw_process,
	.dec_teardown = hw_teardown,
};

#endif /* CONFIG_CRYPTO_STM32 */
```
